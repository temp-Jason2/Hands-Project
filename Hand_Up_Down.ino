// Program to demonstrate the MD_Parola library
//
// Simplest program that does something useful - Hello World!
//
// MD_MAX72XX library can be found at https://github.com/MajicDesigns/MD_MAX72XX
//

#include <MD_Parola.h>
#include <MD_MAX72xx.h>
#include <SPI.h>

// Define the number of devices we have in the chain and the hardware interface
// NOTE: These pin numbers will probably not work with your hardware and may
// need to be adapted
#define HARDWARE_TYPE MD_MAX72XX::FC16_HW
#define MAX_DEVICES 16

#define CLK_PIN   10
#define DATA_PIN  8
#define CS_PIN    9


// Hardware SPI connection
//MD_Parola P = MD_Parola(HARDWARE_TYPE, CS_PIN, MAX_DEVICES);
// Arbitrary output pins
MD_Parola P = MD_Parola(HARDWARE_TYPE, DATA_PIN, CLK_PIN, CS_PIN, MAX_DEVICES);
bool isUp = false;
bool firstPress = true;
bool pressed = 0;
 
MD_MAX72XX::fontType_t yes[] PROGMEM = 
{
	0, 	// 0  - 'NUL'
	0, 	// 1  - 'SOH'
	0, 	// 2  - 'STX'
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	0, 	// 255
};



void setup(void)
{
	pinMode(2,INPUT);
	pinMode(6, OUTPUT);
  	P.begin();
	P.setFont(yes);
  	P.setCharSpacing(0);
}

void up()
{
	P.displayText("ABCDEFGHIJKLMNOP", PA_CENTER, 100, 1000, PA_SCROLL_UP, PA_NO_EFFECT);
}

void down()
{
	P.displayText("ABCDEFGHIJKLMNOP", PA_CENTER, 100, 1000, PA_NO_EFFECT, PA_SCROLL_DOWN);
}



void loop(void)
{
	if (millis() % 2000 < 1750 || isUp || firstPress) {
		digitalWrite(6, LOW);
	} else if (!isUp) {
		digitalWrite(6, HIGH);
	}

  	if (digitalRead(2) == HIGH || pressed){
		pressed = true;
		firstPress = false;
		if (!isUp && P.displayAnimate()) {
			up();
			isUp = true;
			pressed = false;
		} else if (isUp && P.displayAnimate()) {
			down();
			isUp = false;
			pressed = false;
		}
	}
} // 
